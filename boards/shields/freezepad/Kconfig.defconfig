## boards/shields/freezepad/Kconfig.defconfig
```kconfig
if SHIELD_FREEZEPAD

config ZMK_KEYBOARD_NAME
    default "FreezePad"

endif

if SHIELD_FREEZEPAD_DONGLE

config ZMK_KEYBOARD_NAME
    default "FreezePad"

config ZMK_SPLIT_ROLE_CENTRAL
    default y

config ZMK_SPLIT
    default y

config ZMK_SPLIT_BLE_CENTRAL_PERIPHERALS
    default 1

config BT_MAX_CONN
    default 6

config BT_MAX_PAIRED
    default 6

endif
```

## boards/shields/freezepad/Kconfig.shield
```kconfig
config SHIELD_FREEZEPAD
    def_bool $(shields_list_contains,freezepad)

config SHIELD_FREEZEPAD_DONGLE
    def_bool $(shields_list_contains,freezepad_dongle)
```
